/* gm5byte_key.c — GM 5-byte seed-key derivation for T87A (algo 135)
 *
 * Precomputed AES-128 keys (SHA-256 chain done offline) indexed by seed[4].
 * Only AES-128 encrypt runs at runtime — no SHA-256 needed on MCU.
 */
#include "gm5byte_key.h"
#include <string.h>

/* ---- AES-128 S-Box ---- */
static const uint8_t SBOX[256] = {
    0x63,0x7C,0x77,0x7B,0xF2,0x6B,0x6F,0xC5,0x30,0x01,0x67,0x2B,0xFE,0xD7,0xAB,0x76,
    0xCA,0x82,0xC9,0x7D,0xFA,0x59,0x47,0xF0,0xAD,0xD4,0xA2,0xAF,0x9C,0xA4,0x72,0xC0,
    0xB7,0xFD,0x93,0x26,0x36,0x3F,0xF7,0xCC,0x34,0xA5,0xE5,0xF1,0x71,0xD8,0x31,0x15,
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    0x8C,0xA1,0x89,0x0D,0xBF,0xE6,0x42,0x68,0x41,0x99,0x2D,0x0F,0xB0,0x54,0xBB,0x16,
};

/* ---- AES-128 round constants ---- */
static const uint8_t RCON[11] = {
    0x00, 0x01, 0x02, 0x04, 0x08, 0x10, 0x20, 0x40, 0x80, 0x1B, 0x36
};

/* ---- Precomputed AES keys for T87A algo 135 ----
 * Indexed by seed[4] (0..10).  Each is SHA-256^(10-seed[4])(secret)[:16]. */
static const uint8_t T87A_AES_KEYS[11][16] = {
    { 0xC1,0xB1,0xE7,0x5F,0x3F,0xCF,0x5B,0x54,0xE6,0x40,0x6C,0x12,0x58,0x43,0x65,0xF9 },
    { 0xE0,0xA5,0x83,0x3B,0xA3,0xF4,0xA8,0x45,0xD9,0xCD,0x54,0x68,0xE4,0xE3,0x43,0xEE },
    { 0xCB,0x34,0xF9,0x1C,0x24,0x94,0xE6,0xB5,0xD5,0x67,0x0D,0xAA,0x0D,0xDD,0x9F,0x50 },
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    { 0x09,0x03,0xD2,0x26,0xA2,0x40,0x50,0x5D,0xF4,0x91,0x4B,0x84,0x87,0x5E,0x64,0x0D },
};

/* ---- AES-128 encrypt (single block, in-place) ---- */

static uint8_t xtime(uint8_t x) {
    return (uint8_t)((x << 1) ^ (((x >> 7) & 1) * 0x1B));
}

static void sub_bytes(uint8_t *state) {
    for (int i = 0; i < 16; i++)
        state[i] = SBOX[state[i]];
}

static void shift_rows(uint8_t *s) {
    uint8_t t;
    /* row 1: shift left 1 */
    t = s[1]; s[1] = s[5]; s[5] = s[9]; s[9] = s[13]; s[13] = t;
    /* row 2: shift left 2 */
    t = s[2]; s[2] = s[10]; s[10] = t;
    t = s[6]; s[6] = s[14]; s[14] = t;
    /* row 3: shift left 3 (= right 1) */
    t = s[15]; s[15] = s[11]; s[11] = s[7]; s[7] = s[3]; s[3] = t;
}

static void mix_columns(uint8_t *s) {
    for (int c = 0; c < 4; c++) {
        int i = c * 4;
        uint8_t a0 = s[i], a1 = s[i+1], a2 = s[i+2], a3 = s[i+3];
        s[i]   = xtime(a0) ^ xtime(a1) ^ a1 ^ a2 ^ a3;
        s[i+1] = a0 ^ xtime(a1) ^ xtime(a2) ^ a2 ^ a3;
        s[i+2] = a0 ^ a1 ^ xtime(a2) ^ xtime(a3) ^ a3;
        s[i+3] = xtime(a0) ^ a0 ^ a1 ^ a2 ^ xtime(a3);
    }
}

static void add_round_key(uint8_t *state, const uint8_t *rk) {
    for (int i = 0; i < 16; i++)
        state[i] ^= rk[i];
}

static void aes128_encrypt(const uint8_t key[16], const uint8_t in[16], uint8_t out[16]) {
    uint8_t rk[176]; /* 11 round keys × 16 bytes */
    uint8_t state[16];

    /* Key expansion */
    memcpy(rk, key, 16);
    for (int i = 4; i < 44; i++) {
        uint8_t t[4];
        memcpy(t, &rk[(i-1)*4], 4);
        if (i % 4 == 0) {
            uint8_t tmp = t[0];
            t[0] = SBOX[t[1]] ^ RCON[i/4];
            t[1] = SBOX[t[2]];
            t[2] = SBOX[t[3]];
            t[3] = SBOX[tmp];
        }
        for (int j = 0; j < 4; j++)
            rk[i*4+j] = rk[(i-4)*4+j] ^ t[j];
    }

    /* Encrypt */
    memcpy(state, in, 16);
    add_round_key(state, &rk[0]);
    for (int r = 1; r < 10; r++) {
        sub_bytes(state);
        shift_rows(state);
        mix_columns(state);
        add_round_key(state, &rk[r*16]);
    }
    sub_bytes(state);
    shift_rows(state);
    add_round_key(state, &rk[160]);
    memcpy(out, state, 16);
}

/* ---- Public API ---- */

bool gm5byte_compute_key(const uint8_t seed[5], uint8_t key_out[5]) {
    uint8_t tail = seed[4];
    if (tail > 10) return false;

    /* Build plaintext: 11 bytes of 0xFF + 5 bytes of seed */
    uint8_t block[16];
    memset(block, 0xFF, 11);
    memcpy(&block[11], seed, 5);

    /* Encrypt with precomputed AES key */
    uint8_t ct[16];
    aes128_encrypt(T87A_AES_KEYS[tail], block, ct);

    /* MAC = first 5 bytes of ciphertext */
    memcpy(key_out, ct, 5);
    return true;
}
